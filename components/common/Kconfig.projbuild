## components/common/Kconfig.projbuild
```kconfig
menu "Example Configuration"

    
    config OPENWEATHERMAP_API_KEY
    string "OpenWeatherMap API key"
	default "f8746efe17f17891636d685af60199b9"
	help
		API key obtained from 'https://home.openweathermap.org/' site.
		
		You need to set up a free account on this site first.


    config ESP_WIFI_SSID
        string "router"
        default "iQOO"
        help
            SSID (network name) for the example to connect to.

    config ESP_WIFI_PASSWORD
        string "Megatron@123"
        default "nehalrohit"
        help
            WiFi password (WPA or WPA2) for the example to use.

    config ESP_MAXIMUM_RETRY
        int "Maximum retry"
        default 5
        help
            Set the Maximum retry to avoid station reconnecting to the AP unlimited when the AP is really inexistent.
        config EXAMPLE_MOUNT_SD_CARD
            bool "Use SD card for file storage"
            default n
            help
                If this config item is set, the file you upload to server can be chosen to save in the SDcard.
    
        config EXAMPLE_FORMAT_IF_MOUNT_SDCARD_FAILED
            bool "Format the card if mount failed"
            default n
            depends on EXAMPLE_MOUNT_SD_CARD
            help
                If this config item is set, the card will be formatted if mount has failed.
    
        config EXAMPLE_USE_SDMMC_HOST
            bool "Use SDMMC host"
            default y
            depends on EXAMPLE_MOUNT_SD_CARD && SOC_SDMMC_HOST_SUPPORTED
            help
                If this config item is set, SDMMC is used to mount the SDcard.
                Otherwise, will use SPI host to access and mount the SDcard.
        
    config EXAMPLE_HTTPD_CONN_CLOSE_HEADER
        bool "Send connection close header from request handlers"
        default y
        help
            If this config item is set, Connection: close header will be set in handlers.
            This closes HTTP connection and frees the server socket instantly.
endmenu
```

## sdkconfig.defaults
```kconfig
CONFIG_ESPTOOLPY_FLASHSIZE_4MB=y
CONFIG_PARTITION_TABLE_SINGLE_APP=
CONFIG_PARTITION_TABLE_TWO_OTA=
CONFIG_PARTITION_TABLE_CUSTOM=y
CONFIG_PARTITION_TABLE_CUSTOM_FILENAME="partitions.csv"
CONFIG_PARTITION_TABLE_FILENAME="partitions.csv"
CONFIG_PARTITION_TABLE_OFFSET=0x8000
CONFIG_PARTITION_TABLE_MD5=y
CONFIG_HTTPD_MAX_REQ_HDR_LEN=1024

# mbedtls
CONFIG_MBEDTLS_DYNAMIC_BUFFER=y
CONFIG_MBEDTLS_DYNAMIC_FREE_PEER_CERT=y
CONFIG_MBEDTLS_DYNAMIC_FREE_CONFIG_DATA=y
CONFIG_MBEDTLS_CERTIFICATE_BUNDLE_DEFAULT_CMN=y

# For BLE Provisioning using NimBLE stack (Not applicable for ESP32-S2)
CONFIG_BT_ENABLED=y
CONFIG_BTDM_CTRL_MODE_BLE_ONLY=y
CONFIG_BT_NIMBLE_ENABLED=y
CONFIG_BT_CLASSIC_ENABLED=y
CONFIG_BT_CTRL_BLE_MESH_SCAN_DUPL_EN=y
CONFIG_BT_CTRL_SCAN_DUPL_TYPE_DATA_DEVICE=y
CONFIG_BT_BLE_42_FEATURES_SUPPORTED=y
CONFIG_BLE_MESH_SETTINGS=y
CONFIG_BT_SPP_ENABLED=y
CONFIG_BT_CTRL_COEX_PARAMETERS_ENABLE=y
CONFIG_BT_CTRL_COEX_USE_HOOKS=y
CONFIG_BT_GATTS_SEND_SERVICE_CHANGE_MANUAL=y
CONFIG_BT_BTU_TASK_STACK_SIZE=4512

# Override some defaults of ESP BLE Mesh
CONFIG_BLE_MESH=y
CONFIG_BLE_MESH_PROVISIONER=y
CONFIG_BLE_MESH_PB_GATT=y
CONFIG_BLE_MESH_TX_SEG_MSG_COUNT=10
CONFIG_BLE_MESH_RX_SEG_MSG_COUNT=10
CONFIG_BLE_MESH_CFG_CLI=y
CONFIG_BLE_MESH_SENSOR_CLI=y
CONFIG_BLE_MESH_PBA_SAME_TIME=3
CONFIG_BLE_MESH_CRPL=60
CONFIG_BLE_MESH_MSG_CACHE_SIZE=60
CONFIG_BLE_MESH_ADV_BUF_COUNT=200
CONFIG_BLE_MESH_TRACE_LEVEL_ERROR=y
# Temporary Fix for Timer Overflows
CONFIG_FREERTOS_TIMER_TASK_STACK_DEPTH=3120

# For additional security on reset to factory
CONFIG_ESP_RMAKER_USER_ID_CHECK=y

# Secure Local Control
CONFIG_ESP_RMAKER_LOCAL_CTRL_ENABLE=y
CONFIG_ESP_RMAKER_LOCAL_CTRL_SECURITY_1=y

# Application Rollback
CONFIG_BOOTLOADER_APP_ROLLBACK_ENABLE=y


# Override some defaults so BT stack is enabled
# by default in this example
CONFIG_BTDM_CTRL_MODE_BR_EDR_ONLY=n
CONFIG_BTDM_CTRL_MODE_BTDM=n
CONFIG_CTRL_BTDM_MODEM_SLEEP=n
CONFIG_BTDM_SCAN_DUPL_TYPE_DATA_DEVICE=y
CONFIG_BTDM_BLE_MESH_SCAN_DUPL_EN=y
```
